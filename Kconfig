## Kconfig
```kconfig
menu "Graphics Libraries Configuration"
    config GRAPHIC_UI_MENU
        bool "Enable Graphics UI"
        select GRAPHIC_UI
        help
            Enable entire UI module. If disabled, none of the UI components will be compiled.

    if GRAPHIC_UI
        rsource "LVGL/Kconfig"
        rsource "third_party/Kconfig"
    endif
endmenu

config GRAPHIC_UI
bool
```

## LVGL/Kconfig
```kconfig
menu "Graphics Library Selection"
    config LVGL_ENABLE
        bool "Enable LVGL Graphics Library"
        default n
        help
            Enable LVGL for graphical user interface.
            Disable this to exclude LVGL completely.

    if LVGL_ENABLE
        choice
            prompt "LVGL Version"
            default LVGL_8_3
            help
                Select the version of LVGL graphics library.

            config LVGL_8_3
                bool "LVGL 8.3"
                help
                    Use stable LVGL 8.3 (recommended for legacy projects).

            config LVGL_9_3
                bool "LVGL 9.3"
                select LIBJPEG_TURBO_ENABLE
                help
                    Use latest LVGL 9.3 with new features and optimizations.
        endchoice
    endif

    if LVGL_9_3
        choice
            prompt "LVGL Demos"
            default LV_DEMO_WIDGETS
            help
                Select the demo for LVGL

            config LV_DEMO_WIDGETS
                bool "lv demo widgets"
                help
                    Show some widget.

            config LV_DEMO_STRESS
                bool "lv demo stress"
                help
                    Stress test for LVGL

            config LV_DEMO_MUSIC
                bool "lv demo music"
                help
                    Music player demo

            config LV_DEMO_BENCHMARK
                bool "lv demo benchmark"
                help
                    Benchmark your system
        endchoice
    endif
endmenu

menu "Panel Selection"
    choice
        prompt "Select Panel"
        config ST7701S_MENU
            bool "St7701s"
            select ST7701S

        config ST7701S_RGB565_MENU
            bool "St7701s_rgb565"
            select ST7701S_RGB565

        config ST7701P_RGB_MENU
            bool "St7701p_rgb"
            select ST7701P_RGB

        config HJ3508_12_MENU
            bool "Hj3508_12"
            select HJ3508_12

        config B1620A_MENU
            bool "B1620A"
            select B1620A

        config T1720A_MENU
            bool "T1720A"
            select T1720A

        config JD9165BA_MENU
            bool "JD9165BA"
            select JD9165BA
    endchoice
endmenu

config ST7701S
bool

config HJ3508_12
bool

config B1620A
bool

config T1720A
bool

config ST7701S_RGB565
bool

config ST7701P_RGB
bool

config JD9165BA
bool
```

## third_party/Kconfig
```kconfig
menu "Third Party Libraries"
    config LIBJPEG_TURBO_ENABLE
        bool "Enable libjpeg-turbo"
        default n
        help
            Enable JPEG image support via libjpeg-turbo (faster than standard libjpeg).

    config LIBPNG_ENABLE
        bool "Enable libpng (require zlib)"
        default n
        select ZLIB_ENABLE
        help
            Enable PNG image support via libpng. It require zlib for PNG decoding.

    config ZLIB_ENABLE
        bool "Enable zlib"
        default n
        help
            Enable zlib compression library.

    config QOI_ENABLE
        bool "Enable QOI image format"
        default n
        help
            Enable QOI (Quite OK Image) lossless image format support.
            QOI is a fast, lossless image format with no external dependencies.

    orsource "flashdb/Kconfig"
endmenu
```

## third_party/flashdb/Kconfig
```kconfig
menu "FlashDB Configuration"
    config FLASHDB_ENABLE
        bool "Enable FlashDB"
        select FLASHDB if WHC_HOST || WHC_NONE
        help
          FlashDB is a lightweight embedded database that supports key-value and time series data.
          It is designed for embedded systems with limited resources.
          Note: Only available when WHC_HOST or WHC_NONE is selected.

    if FLASHDB_ENABLE
            config FLASHDB_USING_KVDB
                bool "Enable Key-Value Database (KVDB)"
                default y
                help
                    Enable key-value database feature.

            config FLASHDB_USING_TSDB
                bool "Enable Time Series Database (TSDB)"
                default n
                help
                   Enable time series database feature.

            config FLASHDB_DEBUG_ENABLE
                bool "Enable FlashDB Debug"
                default n
                help
                    Enable debug output for FlashDB.

            config FLASHDB_TEST_ENABLE
                bool "Enable FlashDB Test"
                default n
                help
                  Enable FlashDB test cases.
                  This will include test code and may increase binary size.
    endif
endmenu

config FLASHDB_ENABLE
    bool

config FLASHDB_USING_KVDB
    bool

config FLASHDB_USING_TSDB
    bool

config FLASHDB_DEBUG_ENABLE
    bool

config FLASHDB_TEST_ENABLE
    bool
```
