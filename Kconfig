## Kconfig
```kconfig
menu "Graphics Libraries Configuration"
    config GRAPHIC_UI_MENU
        bool "Enable Graphics UI"
        select GRAPHIC_UI if WHC_HOST || WHC_NONE
        help
            Enable entire UI module. If disabled, none of the UI components will be compiled.
            UI is only built on the WHC host core, or the single core.

    if GRAPHIC_UI_MENU
        rsource "LVGL/Kconfig"
        orsource "frameworks/Kconfig"
        rsource "display/Kconfig"
        rsource "input/Kconfig"
        rsource "third_party/Kconfig"
    endif
endmenu

config GRAPHIC_UI
bool
```

## display/Kconfig
```kconfig
menu "Panel Selection"
    choice
        prompt "Select Panel"
        default ST7789V_SPI_240X320_MENU if AMEBALITE
        default ST7701S_MENU
        config ST7102_MIPI_MENU
            bool "St7102_mipi"
            select ST7102_MIPI

        config ST7701S_MIPI_MENU
            bool "St7701s_mipi"
            select ST7701S_MIPI
            select TOUCH_ENABLE
            select TOUCH_CST328

        config ST7701S_MENU
            bool "St7701s"
            select ST7701S

        config ST7701S_RGB565_MENU
            bool "St7701s_rgb565"
            select ST7701S_RGB565
            select TOUCH_ENABLE
            select PANEL_TOUCH_GT911
            select TOUCH_INVERT_X if TOUCH_GT911
            select TOUCH_INVERT_Y if TOUCH_GT911

        config ST7701P_RGB_MENU
            bool "St7701p_rgb"
            select ST7701P_RGB
            select TOUCH_ENABLE
            select PANEL_TOUCH_GT911
            select TOUCH_INVERT_X if TOUCH_GT911
            select TOUCH_INVERT_Y if TOUCH_GT911

        config HJ3508_12_MENU
            bool "Hj3508_12"
            select HJ3508_12

        config B1620A_MENU
            bool "B1620A"
            select B1620A

        config T1720A_MENU
            bool "T1720A"
            select T1720A
            select TOUCH_ENABLE
            select PANEL_TOUCH_GT911

        config JD9165BA_MENU
            bool "JD9165BA"
            select JD9165BA
            select TOUCH_ENABLE
            select PANEL_TOUCH_GT911

        config AXS15260_MIPI_MENU
            bool "AXS15260_mipi"
            select AXS15260_MIPI

        config GH7002_MENU
            select TOUCH_ENABLE
            select TOUCH_GT9XX
            bool "Gh7002"
            select GH7002

        config ST7789V_SPI_240X320_MENU
            bool "st7789v_spi_240x320"
            select ST7789V_SPI_240X320
    endchoice
endmenu

# the panel module comes with a GT911 touch controller
config PANEL_TOUCH_GT911
bool

config ST7102_MIPI
bool

config ST7701S_MIPI
bool

config ST7701S
bool

config HJ3508_12
bool

config B1620A
bool

config T1720A
bool

config ST7701S_RGB565
bool

config ST7701P_RGB
bool

config JD9165BA
bool

config AXS15260_MIPI
bool

config GH7002
bool

config ST7789V_SPI_240X320
bool
```

## input/Kconfig
```kconfig
menu "Touch Controller Selection"
    config TOUCH_ENABLE
        bool "Enable Touch Screen"
        default n
        help
            Enable touchscreen support.
            When disabled, no touch controller is compiled in.

    if TOUCH_ENABLE
        choice
            prompt "Select Touch Controller"
            default TOUCH_GT911_MENU if PANEL_TOUCH_GT911
            default TOUCH_CST328_MENU
            config TOUCH_CST328_MENU
                bool "CST328"
                select TOUCH_CST328

            config TOUCH_GT911_MENU
                bool "GT911"
                select TOUCH_GT911

            config TOUCH_GT9XX_MENU
                bool "GT9XX"
                select TOUCH_GT9XX

            config TOUCH_TDDI_MENU
                bool "TDDI"
                select TOUCH_TDDI
        endchoice

        if TOUCH_GT911
            config TOUCH_SWAP_XY
                bool "Swap touch X/Y"
                default n
                help
                    Set by how the touch panel is mounted, not by the display panel.

            config TOUCH_INVERT_X
                bool "Invert touch X"

            config TOUCH_INVERT_Y
                bool "Invert touch Y"
        endif
    endif
endmenu

config TOUCH_CST328
    bool

config TOUCH_GT911
    bool

config TOUCH_GT9XX
    bool

config TOUCH_TDDI
    bool
```
